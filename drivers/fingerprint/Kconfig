## drivers/fingerprint/Kconfig
```kconfig
menuconfig SENSORS_FINGERPRINT
	bool "Finger Print Sensor devices"
	help
	  Fingerprint sensor drivers (Samsung).

if SENSORS_FINGERPRINT
config SENSORS_FINGERPRINT_32BITS_PLATFORM_ONLY
	bool "Fingerprint sensor supports only 32bits platform"
	default n
config SENSORS_ET5XX
	tristate "ET5XX fingerprint sensor support"
	default n
	help
	  Egistec ET5XX fingerprint sensor.
endif

config SENSORS_FP_SPI_NUMBER
	int "SPI bus number of the TrustZone-owned fingerprint SPI"
	depends on SENSORS_FINGERPRINT
	default 4

config SENSORS_FP_SPI_GPIO_START
	int "First GPIO of the TrustZone-owned fingerprint SPI"
	depends on SENSORS_FINGERPRINT
	default 12

config SENSORS_FP_SPI_GPIO_END
	int "Last GPIO of the TrustZone-owned fingerprint SPI"
	depends on SENSORS_FINGERPRINT
	default 15
```

## drivers/motor/Kconfig
```kconfig
config MSM_VIBRATOR
	tristate "Samsung GPIO vibrator (timed_output)"
	depends on ANDROID_TIMED_OUTPUT && GPIOLIB
	default n
	help
	  Vibration motor switched by a single GPIO, exposed as
	  /sys/class/timed_output/vibrator/enable for the Samsung vibrator HAL.
```

## drivers/switch/Kconfig
```kconfig
menuconfig SWITCH
	tristate "Switch class support"
	help
	  Say Y here to enable switch class support. This allows
	  monitoring switches by userspace via sysfs and uevent
	  (/sys/class/switch/h2w is what Android's WiredAccessoryManager reads).
```
